## boards/xtensa/esp32s3/esp32s3-eye/Kconfig
```kconfig
#
# For a description of the syntax of this configuration file,
# see the file kconfig-language.txt in the NuttX tools repository.
#

if ARCH_BOARD_ESP32S3_EYE

config ESP32S3_STORAGE_MTD_OFFSET
	hex "Storage MTD base address in SPI Flash"
	default 0x180000
	depends on ESP32S3_MTD
	---help---
		MTD base address in SPI Flash.

config ESP32S3_STORAGE_MTD_SIZE
	hex "Storage MTD size in SPI Flash"
	default 0x100000
	depends on ESP32S3_MTD
	---help---
		MTD size in SPI Flash.

choice ESP32S3_SPIFLASH_FS
	prompt "Mount SPI Flash MTD on bring-up"
	default ESP32S3_SPIFLASH_SMARTFS
	depends on ESP32S3_MTD
	optional
	---help---
		Mount the SPI Flash MTD with the selected File System format on board
		bring-up.
		If not selected, the MTD will be registered as a device node on /dev.

config ESP32S3_SPIFLASH_SMARTFS
	bool "SmartFS"
	select FS_SMARTFS
	select MTD_SMART

config ESP32S3_SPIFLASH_NXFFS
	bool "NXFFS"
	select FS_NXFFS

config ESP32S3_SPIFLASH_SPIFFS
	bool "SPIFFS"
	select FS_SPIFFS

config ESP32S3_SPIFLASH_LITTLEFS
	bool "LittleFS"
	select FS_LITTLEFS

endchoice

config ESP32S3_EYE_LCD
	bool "Enable ESP32-S3 LCD"
	default n
	select ESP32S3_SPI2
	select SPI_CMDDATA
	select LCD
	select LCD_DEV
	select LCD_ST7789
	# select LCD_PORTRAIT
	# select LV_COLOR_16_SWAP
	---help---
		Enable board LCD support, IC is LCD_ST7789V. 

config ESP32S3_EYE_CAM
	bool "Enable ESP32-S3 camera"
	default n
	select VIDEO
	select I2C_RESET
	select ESP32S3_DMA
	---help---
		Enable board camera support, IC is OV2640. 

if ESP32S3_EYE_CAM

config ESP32S3_EYE_CAM_XCLK_MHZ
	int "ESP32-S3-EYE camera XCLK in MHz"
	default 24

endif # ESP32S3_EYE_CAM

endif # ARCH_BOARD_ESP32S3_EYE
```

## libs/libzmq/Kconfig
```kconfig
#
# For a description of the syntax of this configuration file,
# see the file kconfig-language.txt in the NuttX tools repository.
#

menuconfig ZEROMQ
	bool "ZeroMQ"
	depends on HAVE_CXX 
	depends on LIBCXX
	select LIBC_NETDB
	select CXX_EXCEPTION
	select NETDB_DNSCLIENT
	select NETDEV_IFINDEX
	select PTHREAD_MUTEX_TYPES
	select EVENT_FD
	default n
	---help---
		Enable build for ZeroMQ library.

if ZEROMQ

choice
	prompt "I/O thread polling system"
	default ZEROMQ_IO_EPOLL
		
config ZEROMQ_IO_EPOLL
	bool "epoll"
	---help---
		Use 'epoll' I/O thread polling system.

config ZEROMQ_IO_POLL
	bool "poll"
	---help---
		Use 'poll' I/O thread polling system.

config ZEROMQ_IO_SELECT
	bool "select"
	---help---
		Use 'select' I/O thread polling system.

endchoice

config ZEROMQ_IO_EPOLL_CLOEXEC
	bool "Use EPOLL with CLOEXEC"
	depends on ZEROMQ_IO_EPOLL
	default y
	---help---
		Use 'epoll' I/O thread polling system with CLOEXEC.

choice
	prompt "condition variable implementation"
	default ZEROMQ_COND_STL11

config ZEROMQ_CV_NONE
	bool "none"
	---help---
		Use no condition variable implementation.

config ZEROMQ_CV_PTHREADS
	bool "pthread"
	---help---
		Use pthread condition variable implementation

config ZEROMQ_CV_STL11
	bool "stl11"
	---help---
		Use stl11 condition variable implementation.

endchoice
config ZEROMQ_BUILTIN_SHA1
	bool "Use built-in SHA-1"
	default n
	---help---
		Use built-in sha1 implementation.

comment "Transport mechanisms"

config ZEROMQ_IPC
	bool "IPC (Unix Domain Sockets) support"
	select NET_LOCAL
	default n
	---help---
		Suport ipc transport through Unix Domain Sockets.

config ZEROMQ_TCP
	bool "TCP support"
	select NET_TCP
	select NET_TCPBACKLOG
	select NET_TCP_KEEPALIVE
	default n
	---help---
		Suport TCP transport through Sockets.

config ZEROMQ_UDP
	bool "UDP support"
	select NET_UDP
	default n
	---help---
		Suport UDP transport through Sockets.

comment "Library options"

endif # ZEROMQ
```
